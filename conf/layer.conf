## conf/layer.conf
```bitbake
# We have a conf and classes directory, add to BBPATH
BBPATH .= ":${LAYERDIR}"

# We have recipes-* directories, add to BBFILES
BBFILES += "${LAYERDIR}/recipes-*/*/*.bb \
            ${LAYERDIR}/recipes-*/*/*.bbappend"

BBFILE_COLLECTIONS += "meta-tmoore3-stm32mp1"
BBFILE_PATTERN_meta-tmoore3-stm32mp1 = "^${LAYERDIR}/"
BBFILE_PRIORITY_meta-tmoore3-stm32mp1 = "8"

LAYERDEPENDS_meta-tmoore3-stm32mp1 = "core"
LAYERSERIES_COMPAT_meta-tmoore3-stm32mp1 = "mickledore"
```
